## NuttyOS/main/Kconfig
```kconfig
menu "NuttyUNO"

config GAME_CHANNEL
    int "UNO game channel"
    range 0 255
    default 1
    help
        BLE advertising channel for UNO multiplayer sessions. Devices must share the same
        channel to see each other. The host advertises as UNO_<channel>.

endmenu
```

## NuttyOS/main/Kconfig.projbuild
```kconfig
menu "NuttyUNO"

config GAME_CHANNEL
    int "UNO game channel"
    range 0 255
    default 0
    help
        Channel number used for BLE advertisement name (UNO_<channel>) and
        the custom UNO GATT service UUID.

endmenu
```
